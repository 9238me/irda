#include "devices.h"
#include "libs.h"
#include "errno.h"

unsigned short buf[50*50] = {0};
void clear_screen(unsigned short color);

char china[10][16] = {
{0x20,0x70,0x1E,0x10,0x10,0xFF,0x10,0x10,0x50,0x30,0x18,0x16,0x10,0x10,0xD4,0x08},
{0x02,0x0A,0x12,0x12,0x02,0x7F,0x02,0x22,0x22,0x12,0x0C,0x44,0x4A,0x51,0x60,0x40},/*"我",0*/
{0x00,0x80,0x7E,0x44,0x88,0xFE,0x42,0x41,0xFE,0x20,0xE0,0x50,0x88,0x04,0xC2,0x38},
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{0x00,0x3F,0x20,0x20,0x2F,0x20,0x20,0x27,0x20,0x22,0x24,0x2F,0x20,0x20,0x3F,0x20},/*"国",4*/
};

void app_display_test(void)
{
    IODevicesRegister();
    UartDevicesRegister();
    SPIDevicesRegister();
    
    DisplayDevice *ptdev = GetST7789Device();
    if(NULL == ptdev)   return;
    if(ESUCCESS != ptdev->Init(ptdev))  return;
    
    clear_screen(0xFFFF);

    ShowStringEN("I Love You, China!", 0, 0, 0xF800);
    
    for(unsigned char i=0; i<10; i++)
        ShowChineseHalf(&china[i][0], i*8, 16, 0x8F00);
    
    while(1)
    {
    }
}

void clear_screen(unsigned short color)
{
    DisplayDevice *ptdev = GetST7789Device();
    if(NULL == ptdev)   return;
    unsigned short nbuf[240] = {0};
    for(unsigned short i = 0; i<240; i++)
    {
        nbuf[i] = color;
    }

    ptdev->FBBase = (unsigned short *)nbuf;
    for(unsigned short i = 0; i<320; i++)
    {
        ptdev->SetDisplayWindow(ptdev, 0, i, 240, i+1);
        ptdev->Flush(ptdev);
    }
}
